/*
    NO LICENSES

    DISCLAIMER: By downloading and executing this sketch you might commit a criminal fellony in some country.

    This code is for EDUCATIONAL USE ONLY.

    No warranties, no support, no batteries included.

    Author: Christopher Isene <christopher.isene@gmail.com> @cisene
    Revision: 201610291339

    Target device: ESPduino

    Inspiration:
      https://hackaday.com/tag/wifi-throwie/

*/
#include <ESP8266WiFi.h>

extern "C" {
#include "user_interface.h"
}

#define BUILTIN_LED 16
#define USE_SERIAL Serial

/* ======================================================================== */
uint8_t phones[] = {
  0x00, 0x1E, 0x52, // Apple
  0x00, 0x1F, 0xF3, // Apple
  0x00, 0x24, 0x36, // Apple
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  0xF8, 0xDB, 0x7F  // HTC
};
/* ======================================================================== */
uint8_t accesspoints[] = {
  0x00, 0x01, 0x38, // XAVi Technologies Corp.
  0x00, 0x03, 0x52, // Colubris Networks
  0x00, 0x11, 0x95, // D-Link
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  0xF4, 0xCF, 0xE2, // Cisco
};
/* ======================================================================== */
char* ssids[] = {
  "ASUS",
  "All Station Guests",
  "BUTIKEXTVIDEO",
  "DOVADO",
  "GIGABYTE",
  "Glocalnet Wireless",
  "Guest",
  "Guestnet",
  "H&M Free WiFi",
  "ICA - Gratis Wifi",
  "IKEA WiFi",
  "Linksys",
  "Mobile",
  "NETGEAR",
  "Net99",
  "Pressbyran",
  "QuickNetFree",
  "Radisson_Guest",
  "RoverRabbit",
  "SEB Corporate",
  "SEB Guest",
  "SEB Internet",
  "SJ",
  "SJ-Guest",
  "Swedbank Guest",
  "TP-LINK",
  "Telia wifi",
  "Telia wifi1x",
  "Telia-testsignal-bg",
  "VOICE",
  "Vasteras Stad Guest Net",
  "WLAN Zone - The Cloud",
  "WirelessICC",
  "WirelessMobile",
  "arosnet",
  "belkin54g",
  "d-link",
  "default",
  "dlink",
  "edu_internet",
  "eduroam",
  "espressohouse",
  "guest_net",
  "homerun",
  "homerun1x",
  "mobile net",
  "mycloud",
  "scandic_easy",
  "service",
  "skynet",
  "wireless",
  "zyxel"
};
/* ======================================================================== */
// Probe Request packet buffer
uint8_t probereq[128] = {
  /* 00 */  0x40,                               /* Management Frame - Probe Request */
  /* 01 */  0x00,                               /* Frame Control Field #2 - always ZERO */
  /* 02 */  0x00, 0x00,                         /* Duration - always ZERO */
  /* 04 */  0xff, 0xff, 0xff, 0xff, 0xff, 0xff, /* Destination address */
  /* 0a */  0x00, 0x00, 0x00, 0x00, 0x00, 0x00, /* Source address */
  /* 10 */  0xff, 0xff, 0xff, 0xff, 0xff, 0xff, /* Broadcast */
  /* 16 */  0x90, 0x00,                         /* Sequence control - no fragment */
  /* 18 */  0x00, 0x0f,
  /* 1a */  0x41, 0x41, 0x41, 0x41, 0x41, 0x41, 0x41, 0x41, 0x41, 0x41, 0x41, 0x41, 0x41, 0x41, 0x41,
  /* 28 */  0x01, 0x04,
  /* 2a */  0x82,                               /* Basic rate - 1.0Mbit/s */
  /* 2c */  0x84,                               /* Basic rate - 2.0Mbit/s */
  /* 2d */  0x8b,                               /* Basic rate - 5.5Mbit/s */
  /* 2e */  0x96                                /* Basic rate - 11Mbit/s  */
};

/* ======================================================================== */
uint8_t clientBuffer[] = {

  /*
     0x00 - 0x2e is Probe Request frame payload
     0x2f - Spare byte
  */

  /* 00 */
  0x00, 0x00, 0x00, 0x00, 0x00, 0x00, 0x00, 0x00, 0x00, 0x00, 0x00, 0x00, 0x00, 0x00, 0x00, 0x00,
  0x00, 0x00, 0x00, 0x00, 0x00, 0x00, 0x00, 0x00, 0x00, 0x00, 0x00, 0x00, 0x00, 0x00, 0x00, 0x00,
  0x00, 0x00, 0x00, 0x00, 0x00, 0x00, 0x00, 0x00, 0x00, 0x00, 0x00, 0x00, 0x00, 0x00, 0x00, 0x00,

  /* 01 */
  0x00, 0x00, 0x00, 0x00, 0x00, 0x00, 0x00, 0x00, 0x00, 0x00, 0x00, 0x00, 0x00, 0x00, 0x00, 0x00,
  0x00, 0x00, 0x00, 0x00, 0x00, 0x00, 0x00, 0x00, 0x00, 0x00, 0x00, 0x00, 0x00, 0x00, 0x00, 0x00,
  0x00, 0x00, 0x00, 0x00, 0x00, 0x00, 0x00, 0x00, 0x00, 0x00, 0x00, 0x00, 0x00, 0x00, 0x00, 0x00,

  /* 02 */
  0x00, 0x00, 0x00, 0x00, 0x00, 0x00, 0x00, 0x00, 0x00, 0x00, 0x00, 0x00, 0x00, 0x00, 0x00, 0x00,
  0x00, 0x00, 0x00, 0x00, 0x00, 0x00, 0x00, 0x00, 0x00, 0x00, 0x00, 0x00, 0x00, 0x00, 0x00, 0x00,
  0x00, 0x00, 0x00, 0x00, 0x00, 0x00, 0x00, 0x00, 0x00, 0x00, 0x00, 0x00, 0x00, 0x00, 0x00, 0x00,

  /* 03 */
  0x00, 0x00, 0x00, 0x00, 0x00, 0x00, 0x00, 0x00, 0x00, 0x00, 0x00, 0x00, 0x00, 0x00, 0x00, 0x00,
  0x00, 0x00, 0x00, 0x00, 0x00, 0x00, 0x00, 0x00, 0x00, 0x00, 0x00, 0x00, 0x00, 0x00, 0x00, 0x00,
  0x00, 0x00, 0x00, 0x00, 0x00, 0x00, 0x00, 0x00, 0x00, 0x00, 0x00, 0x00, 0x00, 0x00, 0x00, 0x00,

  /* 04 */
  0x00, 0x00, 0x00, 0x00, 0x00, 0x00, 0x00, 0x00, 0x00, 0x00, 0x00, 0x00, 0x00, 0x00, 0x00, 0x00,
  0x00, 0x00, 0x00, 0x00, 0x00, 0x00, 0x00, 0x00, 0x00, 0x00, 0x00, 0x00, 0x00, 0x00, 0x00, 0x00,
  0x00, 0x00, 0x00, 0x00, 0x00, 0x00, 0x00, 0x00, 0x00, 0x00, 0x00, 0x00, 0x00, 0x00, 0x00, 0x00,

  /* 05 */
  0x00, 0x00, 0x00, 0x00, 0x00, 0x00, 0x00, 0x00, 0x00, 0x00, 0x00, 0x00, 0x00, 0x00, 0x00, 0x00,
  0x00, 0x00, 0x00, 0x00, 0x00, 0x00, 0x00, 0x00, 0x00, 0x00, 0x00, 0x00, 0x00, 0x00, 0x00, 0x00,
  0x00, 0x00, 0x00, 0x00, 0x00, 0x00, 0x00, 0x00, 0x00, 0x00, 0x00, 0x00, 0x00, 0x00, 0x00, 0x00,

  /* 06 */
  0x00, 0x00, 0x00, 0x00, 0x00, 0x00, 0x00, 0x00, 0x00, 0x00, 0x00, 0x00, 0x00, 0x00, 0x00, 0x00,
  0x00, 0x00, 0x00, 0x00, 0x00, 0x00, 0x00, 0x00, 0x00, 0x00, 0x00, 0x00, 0x00, 0x00, 0x00, 0x00,
  0x00, 0x00, 0x00, 0x00, 0x00, 0x00, 0x00, 0x00, 0x00, 0x00, 0x00, 0x00, 0x00, 0x00, 0x00, 0x00,

  /* 07 */
  0x00, 0x00, 0x00, 0x00, 0x00, 0x00, 0x00, 0x00, 0x00, 0x00, 0x00, 0x00, 0x00, 0x00, 0x00, 0x00,
  0x00, 0x00, 0x00, 0x00, 0x00, 0x00, 0x00, 0x00, 0x00, 0x00, 0x00, 0x00, 0x00, 0x00, 0x00, 0x00,
  0x00, 0x00, 0x00, 0x00, 0x00, 0x00, 0x00, 0x00, 0x00, 0x00, 0x00, 0x00, 0x00, 0x00, 0x00, 0x00


};
/* ======================================================================== */
uint8_t clientBufferIndex[] = {
  /*
     As many elements as buffer slots

     0x00 - Empty/free slot
     non-zero - Occupied slot

  */
  0x00, 0x00, 0x00, 0x00, 0x00, 0x00, 0x00, 0x00
};

/* ======================================================================== */
uint8_t packet[] = {
  0x00, 0x00, 0x00, 0x00, 0x00, 0x00, 0x00, 0x00, 0x00, 0x00, 0x00, 0x00, 0x00, 0x00, 0x00, 0x00,
  0x00, 0x00, 0x00, 0x00, 0x00, 0x00, 0x00, 0x00, 0x00, 0x00, 0x00, 0x00, 0x00, 0x00, 0x00, 0x00,
  0x00, 0x00, 0x00, 0x00, 0x00, 0x00, 0x00, 0x00, 0x00, 0x00, 0x00, 0x00, 0x00, 0x00, 0x00
};
/* ======================================================================== */
int flipflop = 0;

void setup() {
  USE_SERIAL.begin(115200);
  for (uint8_t t = 5; t > 0; t--) {
    USE_SERIAL.printf("[SETUP] WAIT %d...\n", t);
    USE_SERIAL.flush();
    delay(1000);
  }

  /* Define BUILTIN_LED */
  pinMode(BUILTIN_LED, OUTPUT);

  /* Set Wifi operation mode */
  wifi_set_opmode(STATION_MODE);
  wifi_promiscuous_enable(1);

  Serial.println("Ready!");
}
/* ======================================================================== */
void loop() {
  unsigned int i;
  unsigned int slotIndex;
  unsigned int prf;
  unsigned int oui_idx;
  unsigned int p;
  unsigned int channel;

  /* TODO:
  
    clientBufferIndex[0]
      always stuck on ZERO causing Prepare portion of the code to be
      run on each iteration, packet will not be sent as trigger is TTL != 0

    Destination MAC
      Decide between broadcast FF:FF:FF:FF:FF:FF or a faked OUI + random 3 bytes

    SSID
      Currently 'AAAAAAAAAAAAAAA' but should be triggered on Destination MAC,
      where otherwise a fake SSID string should be copied into the frame.
      Might need adjustment and adaption to SSID length.

    Capability bytes
      Check captured packets and imitate/mimic the capabilities as we want
      to look __exactly__ like random smartphones.
  */


  /* TTL timing for buffer entries */
  for (i = 0; i <= (sizeof(clientBufferIndex) - 0x01); i = i + 0x01) {
    Serial.printf("Slot %d has TTL %d seconds\n", i, clientBufferIndex[i]);
    if (clientBufferIndex[i] != 0x00) {
      clientBufferIndex[i] = (clientBufferIndex[i] - 0x01);
    }
  }

  /* Prepare new faked client into buffer */
  for (i = 0x00; i <= (sizeof(clientBufferIndex) - 0x01); i = i + 0x01) {
    if (clientBufferIndex[i] == 0x00) {
      Serial.printf("START Prepare slot %d\n", i);

      /* Set a random TTL */
      clientBufferIndex[i] = random(0x0f, 0x5a);
      Serial.printf("\tTTL for slot %d set to %d\n", i, clientBufferIndex[i]);

      slotIndex = (i * 0x30);
      Serial.printf("\tSlot %d has offset 0x%4X\n", i, slotIndex);

      /* Copy template into buffer */
      for (prf = 0; prf <= 0x2f; prf = prf + 0x01) {
        clientBuffer[slotIndex + prf] = probereq[prf];
      }

      /* Set randomized OUI + 3 random bytes as source address */
      oui_idx = (random(0, sizeof(phones)) * 0x03);
      for (p = 0x00; p <= 0x03; p = p + 1) {
        clientBuffer[(slotIndex + 0x0a) + p] = phones[oui_idx + p];
      }
      for (p = 0x00; p <= 0x03; p = p + 1) {
        clientBuffer[(slotIndex + 0x0d) + p] = random(0x00, 0xff);
      }

      char tmpBuf[17];
      sprintf(
        tmpBuf,
        "%02X:%02X:%02X:%02X:%02X:%02X",
        clientBuffer[(slotIndex + 0x0a) + 0],
        clientBuffer[(slotIndex + 0x0a) + 1],
        clientBuffer[(slotIndex + 0x0a) + 2],
        clientBuffer[(slotIndex + 0x0a) + 3],
        clientBuffer[(slotIndex + 0x0a) + 4],
        clientBuffer[(slotIndex + 0x0a) + 5]
      );

      Serial.printf("\tSource MAC: %s\n", tmpBuf);


      /* Copy randomized SSID to buffer */

      /* Adjust buffer for SSID length */

      /* Fiddle with speed capabilities */

      Serial.printf("END Prepare slot %d\n", i);
    }
  }

  /* Send frames */
  for (i = 0; i <= (sizeof(clientBufferIndex) - 0x01); i = i + 0x01) {
    if (clientBufferIndex[i] != 0x00) {
      slotIndex = (i * 0x30);

      /* Copy buffer slot to packet */
      for (prf = 0; prf <= 0x2f; prf = prf + 0x01) {
        packet[prf] = clientBuffer[(slotIndex) + prf];
      }

      /* Randomize channel */
      channel = random(0x01, 0x0e);
      wifi_set_channel(channel);

      /* Broadcast broadcast broadcast! */
      for (p = 0; p <= 0x02; p = p + 1) {
        wifi_send_pkt_freedom(packet, 0x2f, 0);
      }
    }

  }

  Serial.println("====================================================================");

  /* Flipflop the blue LED to indicate activity */
  if (flipflop == 0x00) {
    digitalWrite(BUILTIN_LED, LOW);
    flipflop = 0x01;
  } else {
    digitalWrite(BUILTIN_LED, HIGH);
    flipflop = 0x00;
  }

  delay(0x3e8);
}
